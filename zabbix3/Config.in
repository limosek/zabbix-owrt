## zabbix3/Config.in
```kconfig
menu "Core Zabbix configuration"
	depends on PACKAGE_zabbix3-core

	choice 

		prompt "SSL library to use"
		default ZABBIX3_OPENSSL
		help
		   Select SSL library to use for Zabbix

		config ZABBIX3_OPENSSL
		bool "OpenSSL"
		select PACKAGE_libopenssl
	
		config ZABBIX3_GNUTLS
		bool "GnuTLS"
		select PACKAGE_libgnutls

	endchoice

	config ZABBIX3_CURL
		bool "cURL support"
		default n
		select PACKAGE_libcurl

	config ZABBIX3_XML2
		bool "libXML2 support"
		default n
		select PACKAGE_libxml2

	config ZABBIX3_SNMP
		bool "SNMP support"
		default n
		select PACKAGE_libnetsnmp
endmenu
```

## zaf/Config.in
```kconfig
menu "Zabbix framework configuration"
	depends on PACKAGE_zaf

	config ZAF_CURL_INSECURE
		bool "Force insecure curl for https"
		default n

	config ZAF_PLUGINS
		string "Zabbix agent framework plugins to install"
		default "zaf"

	config ZAF_REPO_URL
		string "Url of zabbix repo to download plugins from"
		default "https://raw.githubusercontent.com/limosek/zaf-plugins/master/"

	config ZAF_OPTIONS
		string "Options passed to install script"
		default ""
endmenu
```
